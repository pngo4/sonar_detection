#include "ili9486.h"
#include "stm32f4xx_hal.h"

// === Pin definitions ===
// Change these to match your CubeMX GPIO config
#define MOSI_GPIO_PIN   GPIO_PIN_7  // PA7
#define SCLK_GPIO_PIN   GPIO_PIN_5  // PA5
#define CE0_GPIO_PIN    GPIO_PIN_10 // PA10
#define DC_GPIO_PIN     GPIO_PIN_9  // PA9
#define RST_GPIO_PIN    GPIO_PIN_8  // PA8
#define MOSI_GPIO_PORT  GPIOA
#define SCLK_GPIO_PORT  GPIOA
#define CE0_GPIO_PORT   GPIOA
#define DC_GPIO_PORT    GPIOA
#define RST_GPIO_PORT   GPIOA

// Init table from original source
static const int ili9486_init_seq[] = {
    -1, 0xB0, 0x00,
    -1, 0x11, -2, 250,
    -1, 0x3A, 0x55,
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    -1, 0x29, -2, 250,
    -3
};

// Font details (copy from original)
#define FONT_W  8
#define FONT_H  12
#define FONT_START 0x20
#define FONT_SIZE  94
const unsigned char small_font[] = {
0x00,0x00,0x00,0x00,0x00,0x00,0x00,0x00,0x00,0x00,0x00,0x00, // <Space>
0x00,0x00,0x20,0x20,0x20,0x20,0x20,0x20,0x00,0x20,0x00,0x00, // !
0x00,0x28,0x50,0x50,0x00,0x00,0x00,0x00,0x00,0x00,0x00,0x00, // "
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0x40,0xA4,0x18,0x00,0x00,0x00,0x00,0x00,0x00,0x00,0x00,0x00, // ~
};




static void ms_delay(unsigned ms) {
    HAL_Delay(ms);
}

static void xs_send16(uint16_t data) {
    HAL_GPIO_WritePin(CE0_GPIO_PORT, CE0_GPIO_PIN, GPIO_PIN_RESET);
    for (int i = 0; i < 16; i++) {
        HAL_GPIO_WritePin(MOSI_GPIO_PORT, MOSI_GPIO_PIN, (data & (1 << (15 - i))) ? GPIO_PIN_SET : GPIO_PIN_RESET);
        HAL_GPIO_WritePin(SCLK_GPIO_PORT, SCLK_GPIO_PIN, GPIO_PIN_SET);
        HAL_GPIO_WritePin(SCLK_GPIO_PORT, SCLK_GPIO_PIN, GPIO_PIN_RESET);
    }
    HAL_GPIO_WritePin(CE0_GPIO_PORT, CE0_GPIO_PIN, GPIO_PIN_SET);
}

static void send_cmd(uint16_t cmd) {
    HAL_GPIO_WritePin(DC_GPIO_PORT, DC_GPIO_PIN, GPIO_PIN_RESET);
    xs_send16(cmd);
}

static void send_param(uint16_t param) {
    HAL_GPIO_WritePin(DC_GPIO_PORT, DC_GPIO_PIN, GPIO_PIN_SET);
    xs_send16(param);
}

void ili9486_init(void) {
    // Toggle reset
    HAL_GPIO_WritePin(RST_GPIO_PORT, RST_GPIO_PIN, GPIO_PIN_RESET);
    ms_delay(20);
    HAL_GPIO_WritePin(RST_GPIO_PORT, RST_GPIO_PIN, GPIO_PIN_SET);
    ms_delay(120);

    const int* cmd = ili9486_init_seq;
    int is_cmd = 0;
    for (;;) {
        int v = *cmd++;
        if (v == -1) is_cmd = 1;
        else if (v == -2) { ms_delay(*cmd++); }
        else if (v == -3) break;
        else {
            if (is_cmd) { send_cmd(v); is_cmd = 0; }
            else { send_param(v); }
        }
    }
}

void draw_pixel(uint16_t x, uint16_t y, uint16_t color) {
    send_cmd(0x2A);
    send_param(x >> 8); send_param(x & 0xFF); send_param(x >> 8); send_param(x & 0xFF);
    send_cmd(0x2B);
    send_param(y >> 8); send_param(y & 0xFF); send_param(y >> 8); send_param(y & 0xFF);
    send_cmd(0x2C);
    send_param(color);
}

void fill_screen(uint16_t color) {
    for (uint16_t y = 0; y < 320; y++) {
        for (uint16_t x = 0; x < 480; x++) {
            draw_pixel(x, y, color);
        }
    }
}

static int font_bit(unsigned char c, int xi, int yi) {
    int idx = (int)c - FONT_START;
    if (idx < 0 || idx >= FONT_SIZE || xi>=FONT_W || yi>=FONT_H) return 0;
    return (small_font[idx * FONT_H + yi] << xi) & 0x80;
}

void lcd_printf(int x, int y, const char* str, uint16_t color) {
    int orig_x = x;
    for (; *str; str++) {
        if (*str == '\n') {
            y += (FONT_H + 1);
            x = orig_x;
        } else {
            for (int yi = 0; yi < FONT_H; yi++) {
                for (int xi = 0; xi < FONT_W; xi++) {
                    if (font_bit((unsigned char)*str, xi, yi)) {
                        draw_pixel(x + xi, y + yi, color);
                    }
                }
            }
            x += (FONT_W + 1);
        }
    }
}
